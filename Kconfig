## Kconfig
```kconfig
menu "SMF(State Machine Framework) Configuration"

    config SMF_ANCESTOR_SUPPORT
        bool "States to have 1 or more ancestors"
        help
            If y, then the state machine framework includes ancestor state support

endmenu
```
